## conf/layer.conf
```bitbake
# We have a conf and classes directory, add to BBPATH
BBPATH := "${BBPATH}:${LAYERDIR}"

# We have a recipes directory, add to BBFILES
BBFILES := "${BBFILES} ${LAYERDIR}/recipes-*/*/*.bb \
	${LAYERDIR}/recipes-*/*/*.bbappend \
	"
BBFILE_COLLECTIONS += "ofdpa"
BBFILE_PATTERN_ofdpa := "^${LAYERDIR}/"
BBFILE_PRIORITY_ofdpa = "6"

LAYERVERSION_ofdpa    = "1"

# LAYERDEPENDS_sdn    = "acceleration"
# LAYERDEPENDS_ofdpa    = "openembedded-layer"

LAYERSERIES_COMPAT_ofdpa = "kirkstone"
```
